## arch/arm/mach-mx6/Kconfig
```kconfig
if ARCH_MX6

config ARCH_MX6Q
	bool
	select USB_ARCH_HAS_EHCI
	select ARCH_MXC_IOMUX_V3
	select ARCH_MXC_AUDMUX_V2
	select ARCH_SUPPORTS_MSI
	select ARM_GIC
	select ARCH_HAS_CPUFREQ
	select OC_ETM
	select IMX_HAVE_PLATFORM_IMX_UART
	select IMX_HAVE_PLATFORM_FEC
	select IMX_HAVE_PLATFORM_IMX_ANATOP_THERMAL
	select IMX_HAVE_PLATFORM_IMX_IPUV3
	select IMX_HAVE_PLATFORM_MXC_PWM
	select IMX_HAVE_PLATFORM_LDB
	select IMX_HAVE_PLATFORM_IMX_SPDIF
	select IMX_HAVE_PLATFORM_IMX_VDOA

config FORCE_MAX_ZONEORDER
    int "MAX_ORDER"
    default "13"

config	SOC_IMX6Q
	bool

config	SOC_IMX6SL
	bool

config MACH_MX6Q_ARM2
	bool "Support i.MX 6Quad Armadillo2 platform"
	select ARCH_MX6Q
	select SOC_IMX6Q
	select IMX_HAVE_PLATFORM_IMX_UART
	select IMX_HAVE_PLATFORM_DMA
	select IMX_HAVE_PLATFORM_FEC
	select IMX_HAVE_PLATFORM_GPMI_NFC
	select IMX_HAVE_PLATFORM_SDHCI_ESDHC_IMX
	select IMX_HAVE_PLATFORM_SPI_IMX
	select IMX_HAVE_PLATFORM_IMX_I2C
	select IMX_HAVE_PLATFORM_VIV_GPU
	select IMX_HAVE_PLATFORM_IMX_VPU
	select IMX_HAVE_PLATFORM_IMX_DVFS
	select IMX_HAVE_PLATFORM_IMX_ESAI
	select IMX_HAVE_PLATFORM_IMX_SSI
	select IMX_HAVE_PLATFORM_IMX_ANATOP_THERMAL
	select IMX_HAVE_PLATFORM_FSL_USB2_UDC
	select IMX_HAVE_PLATFORM_MXC_EHCI
	select IMX_HAVE_PLATFORM_FSL_OTG
	select IMX_HAVE_PLATFORM_FSL_USB_WAKEUP
	select IMX_HAVE_PLATFORM_AHCI
	select IMX_HAVE_PLATFORM_IMX_OCOTP
	select IMX_HAVE_PLATFORM_IMX_VIIM
	select IMX_HAVE_PLATFORM_IMX2_WDT
	select IMX_HAVE_PLATFORM_IMX_SNVS_RTC
	select IMX_HAVE_PLATFORM_IMX_PM
	select IMX_HAVE_PLATFORM_MXC_HDMI
	select IMX_HAVE_PLATFORM_IMX_ASRC
	select IMX_HAVE_PLATFORM_IMX_SPDIF
	select IMX_HAVE_PLATFORM_IMX_MIPI_DSI
	select IMX_HAVE_PLATFORM_FLEXCAN
	select IMX_HAVE_PLATFORM_IMX_MIPI_CSI2
	select IMX_HAVE_PLATFORM_PERFMON
	select IMX_HAVE_PLATFORM_MXC_MLB
	select IMX_HAVE_PLATFORM_IMX_EPDC
	select IMX_HAVE_PLATFORM_IMX_ELCDIF
	select IMX_HAVE_PLATFORM_IMX_PXP
	select IMX_HAVE_PLATFORM_IMX_PCIE
	select IMX_HAVE_PLATFORM_IMX_CAAM
	help
	  Include support for i.MX 6Quad Armadillo2 platform. This includes specific
	  configurations for the board and its peripherals.

config MACH_MX6SL_ARM2
	bool "Support i.MX 6SoloLite Armadillo2 platform"
	select ARCH_MX6Q
	select SOC_IMX6SL
	select IMX_HAVE_PLATFORM_IMX_UART
	select IMX_HAVE_PLATFORM_DMA
	select IMX_HAVE_PLATFORM_FEC
	select IMX_HAVE_PLATFORM_SDHCI_ESDHC_IMX
	select IMX_HAVE_PLATFORM_SPI_IMX
	select IMX_HAVE_PLATFORM_IMX_I2C
	select IMX_HAVE_PLATFORM_VIV_GPU
	select IMX_HAVE_PLATFORM_IMX_DVFS
	select IMX_HAVE_PLATFORM_IMX_SSI
	select IMX_HAVE_PLATFORM_IMX_ANATOP_THERMAL
	select IMX_HAVE_PLATFORM_FSL_USB2_UDC
	select IMX_HAVE_PLATFORM_MXC_EHCI
	select IMX_HAVE_PLATFORM_FSL_OTG
	select IMX_HAVE_PLATFORM_FSL_USB_WAKEUP
	select IMX_HAVE_PLATFORM_AHCI
	select IMX_HAVE_PLATFORM_IMX_OCOTP
	select IMX_HAVE_PLATFORM_IMX_VIIM
	select IMX_HAVE_PLATFORM_IMX2_WDT
	select IMX_HAVE_PLATFORM_IMX_SNVS_RTC
	select IMX_HAVE_PLATFORM_IMX_PM
	select IMX_HAVE_PLATFORM_IMX_SPDIF
	select IMX_HAVE_PLATFORM_PERFMON
	select IMX_HAVE_PLATFORM_IMX_EPDC
	select IMX_HAVE_PLATFORM_IMX_SPDC
	select IMX_HAVE_PLATFORM_IMX_PXP
	select IMX_HAVE_PLATFORM_IMX_KEYPAD
	select IMX_HAVE_PLATFORM_IMX_DCP
	select IMX_HAVE_PLATFORM_RANDOM_RNGC
	select ARCH_HAS_RNGC
	help
	  Include support for i.MX 6Sololite Armadillo2 platform. This includes specific
	  configurations for the board and its peripherals.

config MACH_MX6SL_EVK
	bool "Support i.MX 6SoloLite EVK platform"
	select ARCH_MX6Q
	select SOC_IMX6SL
	select IMX_HAVE_PLATFORM_IMX_UART
	select IMX_HAVE_PLATFORM_DMA
	select IMX_HAVE_PLATFORM_FEC
	select IMX_HAVE_PLATFORM_SDHCI_ESDHC_IMX
	select IMX_HAVE_PLATFORM_SPI_IMX
	select IMX_HAVE_PLATFORM_IMX_I2C
	select IMX_HAVE_PLATFORM_VIV_GPU
	select IMX_HAVE_PLATFORM_IMX_DVFS
	select IMX_HAVE_PLATFORM_IMX_SSI
	select IMX_HAVE_PLATFORM_IMX_ANATOP_THERMAL
	select IMX_HAVE_PLATFORM_FSL_USB2_UDC
	select IMX_HAVE_PLATFORM_MXC_EHCI
	select IMX_HAVE_PLATFORM_FSL_OTG
	select IMX_HAVE_PLATFORM_FSL_USB_WAKEUP
	select IMX_HAVE_PLATFORM_AHCI
	select IMX_HAVE_PLATFORM_IMX_OCOTP
	select IMX_HAVE_PLATFORM_IMX_VIIM
	select IMX_HAVE_PLATFORM_IMX2_WDT
	select IMX_HAVE_PLATFORM_IMX_SNVS_RTC
	select IMX_HAVE_PLATFORM_IMX_PM
	select IMX_HAVE_PLATFORM_IMX_SPDIF
	select IMX_HAVE_PLATFORM_PERFMON
	select IMX_HAVE_PLATFORM_IMX_EPDC
	select IMX_HAVE_PLATFORM_IMX_SPDC
	select IMX_HAVE_PLATFORM_IMX_PXP
	select IMX_HAVE_PLATFORM_IMX_FSL_CSI
	select IMX_HAVE_PLATFORM_IMX_KEYPAD
	select IMX_HAVE_PLATFORM_IMX_DCP
	select IMX_HAVE_PLATFORM_RANDOM_RNGC
	select ARCH_HAS_RNGC
	help
	  Include support for i.MX 6Sololite EVK platform. This includes specific
	  configurations for the board and its peripherals.

config MACH_MX6Q_SABRELITE
	bool "Support i.MX 6Quad SABRE Lite platform"
	select ARCH_MX6Q
	select SOC_IMX6Q
	select IMX_HAVE_PLATFORM_IMX_UART
	select IMX_HAVE_PLATFORM_DMA
	select IMX_HAVE_PLATFORM_FEC
	select IMX_HAVE_PLATFORM_GPMI_NFC
	select IMX_HAVE_PLATFORM_SDHCI_ESDHC_IMX
	select IMX_HAVE_PLATFORM_SPI_IMX
	select IMX_HAVE_PLATFORM_IMX_I2C
	select IMX_HAVE_PLATFORM_VIV_GPU
	select IMX_HAVE_PLATFORM_IMX_VPU
	select IMX_HAVE_PLATFORM_IMX_SSI
	select IMX_HAVE_PLATFORM_IMX_ANATOP_THERMAL
	select IMX_HAVE_PLATFORM_FSL_USB2_UDC
	select IMX_HAVE_PLATFORM_MXC_EHCI
	select IMX_HAVE_PLATFORM_FSL_OTG
	select IMX_HAVE_PLATFORM_FSL_USB_WAKEUP
	select IMX_HAVE_PLATFORM_AHCI
	select IMX_HAVE_PLATFORM_IMX_OCOTP
	select IMX_HAVE_PLATFORM_IMX_VIIM
	select IMX_HAVE_PLATFORM_IMX2_WDT
	select IMX_HAVE_PLATFORM_IMX_SNVS_RTC
	select IMX_HAVE_PLATFORM_IMX_PM
	select IMX_HAVE_PLATFORM_MXC_HDMI
	select IMX_HAVE_PLATFORM_IMX_ASRC
	select IMX_HAVE_PLATFORM_FLEXCAN
	select IMX_HAVE_PLATFORM_IMX_CAAM
	help
	  Include support for i.MX 6Quad SABRE Lite platform. This includes specific
	  configurations for the board and its peripherals.

config MACH_MX6Q_SABRESD
	bool "Support i.MX 6Quad SABRESD platform"
	select ARCH_MX6Q
	select SOC_IMX6Q
	select IMX_HAVE_PLATFORM_IMX_UART
	select IMX_HAVE_PLATFORM_DMA
	select IMX_HAVE_PLATFORM_FEC
	select IMX_HAVE_PLATFORM_GPMI_NFC
	select IMX_HAVE_PLATFORM_SDHCI_ESDHC_IMX
	select IMX_HAVE_PLATFORM_SPI_IMX
	select IMX_HAVE_PLATFORM_IMX_I2C
	select IMX_HAVE_PLATFORM_VIV_GPU
	select IMX_HAVE_PLATFORM_IMX_VPU
	select IMX_HAVE_PLATFORM_IMX_SSI
	select IMX_HAVE_PLATFORM_IMX_ANATOP_THERMAL
	select IMX_HAVE_PLATFORM_FSL_USB2_UDC
	select IMX_HAVE_PLATFORM_MXC_EHCI
	select IMX_HAVE_PLATFORM_FSL_OTG
	select IMX_HAVE_PLATFORM_FSL_USB_WAKEUP
	select IMX_HAVE_PLATFORM_AHCI
	select IMX_HAVE_PLATFORM_IMX_OCOTP
	select IMX_HAVE_PLATFORM_IMX_VIIM
	select IMX_HAVE_PLATFORM_IMX2_WDT
	select IMX_HAVE_PLATFORM_IMX_SNVS_RTC
	select IMX_HAVE_PLATFORM_IMX_PM
	select IMX_HAVE_PLATFORM_MXC_HDMI
	select IMX_HAVE_PLATFORM_IMX_ASRC
	select IMX_HAVE_PLATFORM_FLEXCAN
	select IMX_HAVE_PLATFORM_IMX_PCIE
	select IMX_HAVE_PLATFORM_IMX_CAAM
	help
	  Include support for i.MX 6Quad SABRE SD platform. This includes specific
	  configurations for the board and its peripherals.

config MACH_MX6Q_SABREAUTO
	bool "Support i.MX 6Quad SABRE Auto platform"
	select ARCH_MX6Q
	select SOC_IMX6Q
	select IMX_HAVE_PLATFORM_IMX_UART
	select IMX_HAVE_PLATFORM_DMA
	select IMX_HAVE_PLATFORM_FEC
	select IMX_HAVE_PLATFORM_GPMI_NFC
	select IMX_HAVE_PLATFORM_SDHCI_ESDHC_IMX
	select IMX_HAVE_PLATFORM_SPI_IMX
	select IMX_HAVE_PLATFORM_IMX_I2C
	select IMX_HAVE_PLATFORM_VIV_GPU
	select IMX_HAVE_PLATFORM_IMX_VPU
	select IMX_HAVE_PLATFORM_IMX_DVFS
	select IMX_HAVE_PLATFORM_IMX_ESAI
	select IMX_HAVE_PLATFORM_IMX_ANATOP_THERMAL
	select IMX_HAVE_PLATFORM_FSL_USB2_UDC
	select IMX_HAVE_PLATFORM_MXC_EHCI
	select IMX_HAVE_PLATFORM_FSL_OTG
	select IMX_HAVE_PLATFORM_FSL_USB_WAKEUP
	select IMX_HAVE_PLATFORM_AHCI
	select IMX_HAVE_PLATFORM_IMX_OCOTP
	select IMX_HAVE_PLATFORM_IMX_VIIM
	select IMX_HAVE_PLATFORM_IMX2_WDT
	select IMX_HAVE_PLATFORM_IMX_SNVS_RTC
	select IMX_HAVE_PLATFORM_IMX_PM
	select IMX_HAVE_PLATFORM_MXC_HDMI
	select IMX_HAVE_PLATFORM_IMX_ASRC
	select IMX_HAVE_PLATFORM_IMX_SPDIF
	select IMX_HAVE_PLATFORM_IMX_MIPI_DSI
	select IMX_HAVE_PLATFORM_FLEXCAN
	select IMX_HAVE_PLATFORM_IMX_MIPI_CSI2
	select IMX_HAVE_PLATFORM_IMX_PCIE
	select IMX_HAVE_PLATFORM_IMX_CAAM
	help
	  Include support for i.MX 6Quad SABRE Auto platform. This includes specific
	  configurations for the board and its peripherals.

config MACH_MX6Q_HDMIDONGLE
	bool "Support i.MX 6Quad HDMIDONGLE platform"
	select ARCH_MX6Q
	select SOC_IMX6Q
	select IMX_HAVE_PLATFORM_IMX_UART
	select IMX_HAVE_PLATFORM_DMA
	select IMX_HAVE_PLATFORM_GPMI_NFC
	select IMX_HAVE_PLATFORM_SDHCI_ESDHC_IMX
	select IMX_HAVE_PLATFORM_SPI_IMX
	select IMX_HAVE_PLATFORM_IMX_I2C
	select IMX_HAVE_PLATFORM_VIV_GPU
	select IMX_HAVE_PLATFORM_IMX_VPU
	select IMX_HAVE_PLATFORM_IMX_DVFS
	select IMX_HAVE_PLATFORM_IMX_ANATOP_THERMAL
	select IMX_HAVE_PLATFORM_FSL_USB2_UDC
	select IMX_HAVE_PLATFORM_MXC_EHCI
	select IMX_HAVE_PLATFORM_FSL_OTG
	select IMX_HAVE_PLATFORM_FSL_USB_WAKEUP
	select IMX_HAVE_PLATFORM_AHCI
	select IMX_HAVE_PLATFORM_IMX_OCOTP
	select IMX_HAVE_PLATFORM_IMX_VIIM
	select IMX_HAVE_PLATFORM_IMX2_WDT
	select IMX_HAVE_PLATFORM_IMX_SNVS_RTC
	select IMX_HAVE_PLATFORM_IMX_PM
	select IMX_HAVE_PLATFORM_MXC_HDMI
	select IMX_HAVE_PLATFORM_IMX_PCIE
	help
	  Include support for i.MX 6Quad HDMI Dongle platform. This includes specific
	  configurations for the board and its peripherals.


config SOM_SECO
	bool

config MACH_MX6_SECO_Q7
        bool "Support i.MX 6 Quad/DualSolo/DualLite SECO Q7 platform"
	select ARCH_MX6Q
	select SOC_IMX6Q
	select SOM_SECO
	select IMX_HAVE_PLATFORM_IMX_UART
	select IMX_HAVE_PLATFORM_DMA
	select IMX_HAVE_PLATFORM_FEC
	select IMX_HAVE_PLATFORM_GPMI_NFC
	select IMX_HAVE_PLATFORM_SDHCI_ESDHC_IMX
	select IMX_HAVE_PLATFORM_SPI_IMX
	select IMX_HAVE_PLATFORM_IMX_I2C
	select IMX_HAVE_PLATFORM_VIV_GPU
	select IMX_HAVE_PLATFORM_IMX_VPU
	select IMX_HAVE_PLATFORM_IMX_DVFS
	select IMX_HAVE_PLATFORM_IMX_ESAI
	select IMX_HAVE_PLATFORM_IMX_ANATOP_THERMAL
	select IMX_HAVE_PLATFORM_FSL_USB2_UDC
	select IMX_HAVE_PLATFORM_MXC_EHCI
	select IMX_HAVE_PLATFORM_FSL_OTG
	select IMX_HAVE_PLATFORM_FSL_USB_WAKEUP
	select IMX_HAVE_PLATFORM_AHCI
	select IMX_HAVE_PLATFORM_IMX_OCOTP
	select IMX_HAVE_PLATFORM_IMX_VIIM
	select IMX_HAVE_PLATFORM_IMX2_WDT
	select IMX_HAVE_PLATFORM_IMX_SNVS_RTC
	select IMX_HAVE_PLATFORM_IMX_PM
	select IMX_HAVE_PLATFORM_MXC_HDMI
	select IMX_HAVE_PLATFORM_IMX_ASRC
	select IMX_HAVE_PLATFORM_IMX_SPDIF
	select IMX_HAVE_PLATFORM_IMX_MIPI_DSI
	select IMX_HAVE_PLATFORM_FLEXCAN
	select IMX_HAVE_PLATFORM_IMX_MIPI_CSI2
	select IMX_HAVE_PLATFORM_IMX_PCIE
	select IMX_HAVE_PLATFORM_IMX_CAAM
        help
          Include support for i.MX6 Solo/DualLite SECO Q7 platform. This includes specific
          configurations for the board and its peripherals.

config MACH_MX6_SECO_UQ7
        bool "Support i.MX 6 Quad/DualSolo/DualLite SECO uQ7 platform"
	select ARCH_MX6Q
	select SOC_IMX6Q
	select SOM_SECO
	select IMX_HAVE_PLATFORM_IMX_UART
	select IMX_HAVE_PLATFORM_DMA
	select IMX_HAVE_PLATFORM_FEC
	select IMX_HAVE_PLATFORM_GPMI_NFC
	select IMX_HAVE_PLATFORM_SDHCI_ESDHC_IMX
	select IMX_HAVE_PLATFORM_SPI_IMX
	select IMX_HAVE_PLATFORM_IMX_I2C
	select IMX_HAVE_PLATFORM_VIV_GPU
	select IMX_HAVE_PLATFORM_IMX_VPU
	select IMX_HAVE_PLATFORM_IMX_DVFS
	select IMX_HAVE_PLATFORM_IMX_ESAI
	select IMX_HAVE_PLATFORM_IMX_ANATOP_THERMAL
	select IMX_HAVE_PLATFORM_FSL_USB2_UDC
	select IMX_HAVE_PLATFORM_MXC_EHCI
	select IMX_HAVE_PLATFORM_FSL_OTG
	select IMX_HAVE_PLATFORM_FSL_USB_WAKEUP
	select IMX_HAVE_PLATFORM_AHCI
	select IMX_HAVE_PLATFORM_IMX_OCOTP
	select IMX_HAVE_PLATFORM_IMX_VIIM
	select IMX_HAVE_PLATFORM_IMX2_WDT
	select IMX_HAVE_PLATFORM_IMX_SNVS_RTC
	select IMX_HAVE_PLATFORM_IMX_PM
	select IMX_HAVE_PLATFORM_MXC_HDMI
	select IMX_HAVE_PLATFORM_IMX_ASRC
	select IMX_HAVE_PLATFORM_IMX_SPDIF
	select IMX_HAVE_PLATFORM_IMX_MIPI_DSI
	select IMX_HAVE_PLATFORM_FLEXCAN
	select IMX_HAVE_PLATFORM_IMX_MIPI_CSI2
	select IMX_HAVE_PLATFORM_IMX_PCIE
	select IMX_HAVE_PLATFORM_IMX_CAAM
        help
          Include support for i.MX6 Solo/DualLite SECO Q7 platform. This includes specific
          configurations for the board and its peripherals.


config MACH_MX6_SECO_UDOO
        bool "Support i.MX 6 Quad and DualLite SECO UDOO platform"
	select ARCH_MX6Q
	select SOC_IMX6Q
	select SOM_SECO
	select IMX_HAVE_PLATFORM_IMX_UART
	select IMX_HAVE_PLATFORM_DMA
	select IMX_HAVE_PLATFORM_FEC
	select IMX_HAVE_PLATFORM_GPMI_NFC
	select IMX_HAVE_PLATFORM_SDHCI_ESDHC_IMX
	select IMX_HAVE_PLATFORM_SPI_IMX
	select IMX_HAVE_PLATFORM_IMX_I2C
	select IMX_HAVE_PLATFORM_VIV_GPU
	select IMX_HAVE_PLATFORM_IMX_VPU
	select IMX_HAVE_PLATFORM_IMX_DVFS
	select IMX_HAVE_PLATFORM_IMX_ESAI
	select IMX_HAVE_PLATFORM_IMX_ANATOP_THERMAL
	select IMX_HAVE_PLATFORM_FSL_USB2_UDC
	select IMX_HAVE_PLATFORM_MXC_EHCI
	select IMX_HAVE_PLATFORM_FSL_OTG
	select IMX_HAVE_PLATFORM_FSL_USB_WAKEUP
	select IMX_HAVE_PLATFORM_AHCI
	select IMX_HAVE_PLATFORM_IMX_OCOTP
	select IMX_HAVE_PLATFORM_IMX_VIIM
	select IMX_HAVE_PLATFORM_IMX2_WDT
	select IMX_HAVE_PLATFORM_IMX_SNVS_RTC
	select IMX_HAVE_PLATFORM_IMX_PM
	select IMX_HAVE_PLATFORM_MXC_HDMI
	select IMX_HAVE_PLATFORM_IMX_ASRC
	select IMX_HAVE_PLATFORM_IMX_SPDIF
	select IMX_HAVE_PLATFORM_IMX_MIPI_DSI
	select IMX_HAVE_PLATFORM_FLEXCAN
	select IMX_HAVE_PLATFORM_IMX_MIPI_CSI2
	select IMX_HAVE_PLATFORM_IMX_CAAM
        help
          Include support for i.MX6 DualLite and Quad SECO UDOO platform. This includes specific
          configurations for the board and its peripherals.


comment "MX6 Options:"

####### SECO MENU FEATURES #######

menu "Seco Qseven Option"
        depends on MACH_MX6_SECO_Q7 || MACH_MX6_SECO_UQ7 

config Q7_SATA_AHCI
        bool "Q7 SATA support"
	select SATA_AHCI
	select SATA_AHCI_PLATFORM
        help
            This option enables support for Platform AHCI Serial ATA controllers.
            on seco Q7.

            If unsure, say Y.

config Q7_PCIE
        bool "Q7 PCIE support"
	select IMX_PCIE
        help
            This option enables support for PCIE bus and peripheral
            on seco Q7.

            If unsure, say Y.

config Q7_ATH9KL
        bool "Q7 wifi card Atheros ATH9KL"
        depends on Q7_PCIE
	select PCI
	select WLAN
	select ATH9K
	select MAC80211
	select ATH9K_PCI
	select ATH_COMMON
	select NETDEVICES

        help
            say Y here if you have a Seco Q7 board and want to use Atheros ATH9K WiFi chip.

            If unsure, say Y.

config Q7_MTD_M25P80
        bool "Q7 M25P80 spi flash device"
        depends on SPI_MASTER && GENERIC_HARDIRQS
	select MTD_M25P80
        help
            say Y here if you have a Seco Q7 board and want to access flash SPI device.

            If unsure, say N.

config Q7_SND_SOC_IMX_AC97_VT1613
        bool "Q7 'AC97 AUDIO CODEC VT1613"
        depends on SND_IMX_SOC && SOUND && SND_SOC
	select SND_SOC_IMX_AC97_VT1613
        help
            say Y here if you have a Seco Q7 board and want to use audio codec 'AC97.

            If unsure, say Y.

config Q7_TOUCHSCREEN_TSC2006
        bool "TSC2006 based touchscreen"
        depends on SPI_MASTER && GENERIC_HARDIRQS
	select TOUCHSCREEN_TSC2006
        help
            say Y here if you have a TSC2006 based Touchscreen.

            If unsure, say N.

config Q7_TOUCHSCREEN_TSC2004
        bool "TSC2004 based touchscreen"
        depends on I2C
	select TOUCHSCREEN_TSC2004
        help
            say Y here if you have a TSC2004 based Touchscreen.

            If unsure, say N.

config Q7_MSP430
        bool "Seco Comunication System with MSP430"
        depends on I2C
        select MSP430
        help
            Say Y here if you want to use the Seco Halt System with MSP430.

            If usure, say Y.
            
config Q7_PMIC_PFUZE100
        bool "Freescale PMIC PFuze100"
        depends on I2C
	select REGULATOR
	select MFD_PFUZE
	select REGULATOR_PFUZE100
	
        help
            say Y here if you have a PFUZE100 on board

            If unsure, say N.


menu "Support for Q7 SDIO interface"

if MACH_MX6_SECO_Q7
config Q7_EMMC_INTERFACE
	bool "Support for on board eMMC memory"
	help
		Support for on board eMMC memory

config Q7_SD1_INTERFACE
	bool "Support for onboard uSD card"
	help
		Support for onboard uSD card

config Q7_SD2_INTERFACE
	bool "Support for external SD card on carrier board"
	help
		Support for external SD card on carrier board

config Q7_SD3_INTERFACE
	bool "Support for SDIO to CPLD Bus"
	help
		Support for SDIO to CPLD Bus

endif


if MACH_MX6_SECO_UQ7
config UQ7_SD1_INTERFACE
	bool "Support for external SD card on carrier board"
	help
		Support for external SD card on carrier board

config UQ7_EMMC_INTERFACE
	bool "Support for on board eMMC memory"
	help
		Support for on board eMMC memory

config UQ7_SD2_INTERFACE
	bool "Support for external SD 2 card on carrier board"
	help
		Support for external SD 2 card on carrier board

endif
		
endmenu

endmenu

#####################


####### UDOO FEATURES #######

menu "UDOO Option"
        depends on MACH_MX6_SECO_UDOO


config UDOO_DUAL_REVB
        bool "UDOO Dual RevB"
	select DUAL_REVB
        help
            This option enables compilation for UDOO Dual RevB

            If unsure, say N.



config UDOO_SATA_AHCI
        bool "UDOO SATA support"
	select SATA_AHCI
	select SATA_AHCI_PLATFORM
        help
            This option enables support for Platform AHCI Serial ATA controllers.
            on UDOO.

            If unsure, say Y.


config UDOO_SND_SOC_IMX_AC97_VT1613
        bool "UDOO 'AC97 AUDIO CODEC VT1613"
        depends on SND_IMX_SOC && SOUND && SND_SOC
	select SND_SOC_IMX_AC97_VT1613
        help
            say Y here if you have a UDOO board and want to use audio codec 'AC97.

            If unsure, say Y.


menu "External i.MX6 Pinmuxing options"

comment "Testing..."

if MACH_MX6_SECO_UDOO

config SPDIF_SUPPORT
	bool "[NOT WORKING YET] Support for SPDIF - external pinout"
	help
		[NOT WORKING YET] Support for SPDIF - external pinout

endif

		
endmenu

endmenu

#####################


config IMX_PCIE
	bool "PCI Express support"
	select PCI

config USB_EHCI_ARC_H1
	tristate "USB Host 1 support"
	depends on USB_EHCI_ARC

config USB_FSL_ARC_OTG
	tristate "FSL USB OTG support"

config MX6_INTER_LDO_BYPASS
	bool "Internal LDO in MX6Q/DL bypass"
	depends on  REGULATOR_PFUZE100 && CPU_FREQ_IMX && ARCH_MX6
	default n
	help
	 This is choosed for bypass internal LDO in MX6. If choose it, internal
	 LDO will replaced by external pmic regulator(e.g. pfuze100), VDDCORE
	 can be adjust automatically adjust by cpu frequency.

config MX6_CLK_FOR_BOOTUI_TRANS
	bool "MX6 clk setting for smooth UI transtion from bootloader to kernel"
	depends on MXC_IPU_V3H
	default n
	help
	 This is choosed to keep enable IPU related clocks and PWM clocks and
	 avoid setting IPU related clocks' parents when initializing clock tree
	 so that bootloader splashimage can transition to kernel smoothly.

config MACH_IMX_BLUETOOTH_RFKILL
       tristate "i.MX Bluetooth rfkill interface support"
       depends on RFKILL
       ---help---
	Say Y to get the standard rfkill interface of Bluetooth

config MX6_ENET_IRQ_TO_GPIO
	bool "Route ENET interrupts to GPIO"
	default n
	help
	   Enabling this will direct all the ENET interrupts to a board specific GPIO.
	   This will allow the system to enter WAIT mode when ENET is active.

endif
```
